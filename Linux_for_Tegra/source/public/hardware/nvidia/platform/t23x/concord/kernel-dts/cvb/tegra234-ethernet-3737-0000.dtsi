/*
 * Copyright (c) 2021, NVIDIA CORPORATION.  All rights reserved.
 *
 * This program is free software; you can redistribute it and/or modify it
 * under the terms and conditions of the GNU General Public License,
 * version 2, as published by the Free Software Foundation.
 *
 * This program is distributed in the hope it will be useful, but WITHOUT
 * ANY WARRANTY; without even the implied warranty of MERCHANTABILITY or
 * FITNESS FOR A PARTICULAR PURPOSE.  See the GNU General Public License for
 * more details.
 *
 * You should have received a copy of the GNU General Public License
 * along with this program.  If not, see <http://www.gnu.org/licenses/>.
 */

#include <dt-bindings/gpio/tegra234-gpio.h>

/ {
	/* EQOS */
	ethernet@2310000 {
        	status = "okay";
        	nvidia,skip_mac_reset = <0>;
        	nvidia,mac-addr-idx = <0>;
		nvidia,max-platform-mtu = <16383>;
		nvidia,pause_frames = <0>;
        	phy-mode = "rgmii-id";
        	fixed-link {
			speed = <1000>;
			full-duplex;
		};
	};
};
